## base_external/package/aesd-char/Config.in
```kconfig
config BR2_PACKAGE_AESD_CHAR
	bool "aesd-char"
  depends on BR2_LINUX_KERNEL
	help
    custom character linux device driver for assignment 8
```
